## block/oppo_foreground_io_opt/Kconfig
```kconfig
config OPPO_FG_IO_OPT
bool "OPPO foreground IO optimization"
default y
help
  Enables OPPO foreground/background IO queue tuning helpers.
```

## drivers/input/oppo_fp_drivers/Kconfig
```kconfig
menu "OPPO fingerprint drivers"

config OPPO_FINGERPRINT_MTK
bool "OPPO fingerprint MTK"
depends on OPPO_FINGERPRINT
default y

config OPPO_FINGERPRINT_GOODIX_OPTICAL
bool "OPPO fingerprint Goodix optical"
depends on OPPO_FINGERPRINT
default y

config OPPO_FINGERPRINT_GOODIX
bool "OPPO fingerprint Goodix"
depends on OPPO_FINGERPRINT
default y

config OPPO_FINGERPRINT_FPC
bool "OPPO fingerprint FPC"
depends on OPPO_FINGERPRINT
default y

config OPPO_FINGERPRINT_EGIS_OPTICAL
bool "OPPO fingerprint Egis optical"
depends on OPPO_FINGERPRINT
default y

endmenu
```

## drivers/input/touchscreen/oppo_touchscreen/Kconfig
```kconfig
menu "OPPO Touchscreen"

config TOUCHPANEL_OPPO
bool "OPPO Touchpanel support"
default y
help
  Placeholder option for missing vendor touchscreen tree.

endmenu
```

## drivers/misc/mediatek/sensor/2.0/oppo_sensor_devinfo/Kconfig
```kconfig
menu "OPPO sensor devinfo 2.0"

config OPLUS_SENSOR_DEVINFO_V2
bool "OPPO sensor devinfo v2"
default y

endmenu
```

## drivers/misc/mediatek/sensor/2.0/oppo_virtual_sensor/Kconfig
```kconfig
menu "OPPO virtual sensors 2.0"

config OPLUS_VIRTUAL_SENSOR_V2
bool "OPPO virtual sensor v2"
default y

endmenu
```

## drivers/misc/mediatek/sensors-1.0/oppo_sensor_devinfo/Kconfig
```kconfig
menu "OPPO sensor devinfo"

config OPLUS_SENSOR_DEVINFO
bool "OPPO sensor devinfo"
default y

endmenu
```

## drivers/misc/mediatek/sensors-1.0/oppo_virtual_sensor/Kconfig
```kconfig
menu "OPPO virtual sensors"

config OPLUS_VIRTUAL_SENSOR
bool "OPPO virtual sensor"
default y

endmenu
```

## drivers/power/oplus/Kconfig
```kconfig
menu "OPLUS charger stubs"

config OPLUS_CHARGER
bool "OPLUS_CHARGER"
default n

config OPLUS_CHARGER_MTK
bool "OPLUS_CHARGER_MTK"
depends on OPLUS_CHARGER
default n

config OPLUS_CHARGER_MTK6771
bool "OPLUS_CHARGER_MTK6771"
depends on OPLUS_CHARGER_MTK
default n

config OPLUS_CHARGER_BQ24190
bool "OPLUS_CHARGER_BQ24190"
depends on OPLUS_CHARGER
default n

config OPLUS_CHARGER_MT6370_TYPEC
bool "OPLUS_CHARGER_MT6370_TYPEC"
depends on OPLUS_CHARGER
default n

endmenu
```

## drivers/scsi/oufs/Kconfig
```kconfig
menu "OPPO UFS extensions"

config OPLUS_UFS_EXT
bool "OPPO UFS extension stub"
depends on SCSI_UFSHCD
default y

endmenu
```

## drivers/soc/oplus/iomonitor/Kconfig
```kconfig
menu "OPLUS iomonitor"

config IOMONITOR
bool "OPLUS I/O monitor"
default n

config IOMONITOR_WITH_F2FS
bool "OPLUS I/O monitor with F2FS"
depends on IOMONITOR
default n

endmenu
```

## drivers/soc/oplus/lowmem_dbg/Kconfig
```kconfig
menu "OPLUS lowmem debug"
config OPLUS_FEATURE_LOWMEM_DBG
bool "OPLUS LOWMEM DBG"
default n
endmenu
```

## drivers/soc/oplus/oplus_midas/Kconfig
```kconfig
menu "OPLUS midas"
config OPLUS_FEATURE_MIDAS
bool "OPLUS MIDAS"
default n
endmenu
```

## drivers/soc/oplus/oplus_nandswap/Kconfig
```kconfig
menu "OPLUS nandswap"
config NANDSWAP
bool "OPLUS NANDSWAP"
default n
config NANDSWAP_DEBUG
bool "OPLUS NANDSWAP DEBUG"
depends on NANDSWAP
default n
endmenu
```

## drivers/soc/oplus/oppo_healthinfo/Kconfig
```kconfig
menu "OPLUS healthinfo"

config OPLUS_HEALTHINFO
bool "OPLUS healthinfo"
default y

endmenu
```

## drivers/soc/oplus/system/Kconfig
```kconfig
menu "OPLUS system"

config OPLUS_SYSTEM_KERNEL
bool "OPLUS system kernel support"
default y

endmenu
```

## drivers/soc/oppo/oppo_wakelock_profiler/Kconfig
```kconfig
menu "OPPO wakelock profiler"

config OPPO_WAKELOCK_PROFILER
bool "OPPO wakelock profiler"
default y

endmenu
```

## fs/proc/oppo_healthinfo/Kconfig
```kconfig
menu "proc oppo healthinfo"

config PROC_OPPO_HEALTHINFO
bool "proc oppo healthinfo"
default y

endmenu
```

## mm/oppo_healthinfo/Kconfig
```kconfig
menu "OPPO healthinfo"

config OPPO_HEALTHINFO
bool "OPPO healthinfo support"
default y

config OPPO_MEM_MONITOR
bool "OPPO memory monitor"
depends on OPPO_HEALTHINFO
default y

endmenu
```
